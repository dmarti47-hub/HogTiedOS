## buildroot-external/package/hbas-btd/Config.in
```kconfig
config BR2_PACKAGE_HBAS_BTD
	bool "hbas-btd"
	depends on BR2_PACKAGE_DBUS
	depends on BR2_PACKAGE_BLUEZ5_UTILS
	help
	  Phone music over Bluetooth for hogtied-ui: tracks the connected
	  phone and its media player through BlueZ, sends play/pause/
	  next/previous, and confirms pairing on screen. Sources live in
	  software/btd in the HogTiedOS repository.
```

## buildroot-external/package/hbas-gpsd/Config.in
```kconfig
config BR2_PACKAGE_HBAS_GPSD
	bool "hbas-gpsd"
	help
	  u-blox GPS reader for hogtied-ui: finds the receiver's baud rate
	  (stock's 9600 -> PUBX,41 -> 57600 first), parses NMEA, serves the
	  fix on /run/hbas/gps.sock and sets the system clock from GPS time.
	  Sources live in software/gpsd in the HogTiedOS repository.
```

## buildroot-external/package/hbas-iocd/Config.in
```kconfig
config BR2_PACKAGE_HBAS_IOCD
	bool "hbas-iocd"
	help
	  IOC (front/IO controller) link daemon: answers the IOC's power
	  keep-alive like the stock firmware, handles shutdown requests,
	  and forwards bike CAN frames to a SocketCAN interface (vcan0).
	  Sources live in software/iocd in the HogTiedOS repository.
```

## buildroot-external/package/hbas-tunerd/Config.in
```kconfig
config BR2_PACKAGE_HBAS_TUNERD
	bool "hbas-tunerd"
	help
	  AM/FM/WB broadcast radio for hogtied-ui. Drives the Silabs Si4763
	  on I2C bus 1 using the public Si476x command set, and serves the
	  tuner state on /run/hbas/tuner.sock. The on-hardware bring-up
	  (reset line, firmware load) is still unverified; see
	  docs/findings/RADIO.md. Sources live in software/tunerd.
```

## buildroot-external/package/hogtied-lvgl/Config.in
```kconfig
config BR2_PACKAGE_HOGTIED_LVGL
	bool
	help
	  LVGL 9.2.2 sources for hogtied-ui (source only; hogtied-ui
	  builds it with its own lv_conf.h).
```

## buildroot-external/package/hogtied-ui/Config.in
```kconfig
config BR2_PACKAGE_HOGTIED_UI
	bool "hogtied-ui"
	select BR2_PACKAGE_HOGTIED_LVGL
	help
	  HogTiedOS main screen (LVGL 9.2.2 on the Linux framebuffer):
	  speed, gear, rpm, warnings, clock and tire data decoded from
	  bike CAN frames by libhbas. Sources live in software/ in the
	  HogTiedOS repository.
```
